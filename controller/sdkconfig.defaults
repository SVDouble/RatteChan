## controller/sdkconfig.defaults
```kconfig
CONFIG_ESPTOOLPY_FLASHFREQ_80M=y
CONFIG_EXAMPLE_WIFI_SSID="🌚"
CONFIG_EXAMPLE_WIFI_PASSWORD="YourMoonCouldGoHere!"
CONFIG_EXAMPLE_CONNECT_IPV6=n
CONFIG_COMPILER_CXX_EXCEPTIONS=y
CONFIG_COMPILER_CXX_EXCEPTIONS_EMG_POOL_SIZE=1024
```

## extra/esp32-sensor-io/main/Kconfig.projbuild
```kconfig
menu "Ratte"

    config BROKER_URL
        string "Broker URL"
        default "ws://192.168.182.88:9001"
        help
            URL of the broker to connect to

    config PIN_NUM_SDA
        int "I2C SDA Pin"
        default 17

    config PIN_NUM_SCL
        int "I2C SCL Pin"
        default 16


endmenu
```
